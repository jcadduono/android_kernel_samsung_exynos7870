## arch/arm64/configs/exynos7870-emul_defconfig
```kconfig
# CONFIG_SWAP is not set
CONFIG_SYSVIPC=y
CONFIG_NO_HZ=y
CONFIG_HZ=25
CONFIG_HIGH_RES_TIMERS=y
CONFIG_CGROUPS=y
CONFIG_CGROUP_DEBUG=y
CONFIG_CGROUP_FREEZER=y
CONFIG_CGROUP_CPUACCT=y
CONFIG_RESOURCE_COUNTERS=y
CONFIG_CGROUP_SCHED=y
CONFIG_RT_GROUP_SCHED=y
CONFIG_NAMESPACES=y
CONFIG_BLK_DEV_INITRD=y
CONFIG_CC_OPTIMIZE_FOR_SIZE=y
CONFIG_EMBEDDED=y
# CONFIG_COMPAT_BRK is not set
CONFIG_PROFILING=y
CONFIG_MODULES=y
CONFIG_MODULE_UNLOAD=y
CONFIG_MODULE_FORCE_UNLOAD=y
# CONFIG_BLK_DEV_BSG is not set
CONFIG_PARTITION_ADVANCED=y
# CONFIG_IOSCHED_DEADLINE is not set
CONFIG_SOC_EXYNOS7870=y
CONFIG_PWRCAL=y
CONFIG_PREEMPT=y
CONFIG_SMP=y
CONFIG_SCHED_MC=y
# CONFIG_HW_PERF_EVENTS is not set
CONFIG_KSM=y
CONFIG_CMA=y
# CONFIG_EFI is not set
# CONFIG_CORE_DUMP_DEFAULT_ELF_HEADERS is not set
CONFIG_COMPAT=y
CONFIG_PM_AUTOSLEEP=y
CONFIG_PM_WAKELOCKS=y
CONFIG_PM_WAKELOCKS_LIMIT=0
# CONFIG_PM_WAKELOCKS_GC is not set
CONFIG_UEVENT_HELPER_PATH="/sbin/hotplug"
CONFIG_DEVTMPFS=y
CONFIG_DMA_CMA=y
CONFIG_BLK_DEV_LOOP=y
CONFIG_BLK_DEV_RAM=y
CONFIG_BLK_DEV_RAM_SIZE=8192
CONFIG_UID_STAT=y
CONFIG_USE_MUIC=y
CONFIG_MUIC_NOTIFIER=y
CONFIG_MUIC_S2MM001=y
CONFIG_MCU_IPC=y
CONFIG_INPUT_FF_MEMLESS=y
# CONFIG_INPUT_MOUSEDEV is not set
CONFIG_INPUT_EVDEV=y
CONFIG_INPUT_KEYCOMBO=y
CONFIG_KEYBOARD_GPIO=y
CONFIG_KEYBOARD_SAMSUNG=y
# CONFIG_INPUT_MOUSE is not set
# CONFIG_SERIO_SERPORT is not set
# CONFIG_VT is not set
# CONFIG_LEGACY_PTYS is not set
CONFIG_SERIAL_SAMSUNG=y
CONFIG_SERIAL_SAMSUNG_CONSOLE=y
# CONFIG_HW_RANDOM is not set
CONFIG_PINCTRL_EXYNOS=y
CONFIG_GPIOLIB=y
# CONFIG_HWMON is not set
CONFIG_REGULATOR=y
CONFIG_REGULATOR_FIXED_VOLTAGE=y
CONFIG_FB=y
CONFIG_FB_SIMPLE=y
CONFIG_BACKLIGHT_LCD_SUPPORT=y
CONFIG_LCD_CLASS_DEVICE=y
CONFIG_BACKLIGHT_CLASS_DEVICE=y
# CONFIG_BACKLIGHT_GENERIC is not set
# CONFIG_HID is not set
# CONFIG_USB_SUPPORT is not set
CONFIG_EXYNOS_CHIPID=y
CONFIG_EXYNOS_REBOOT=y
# CONFIG_IOMMU_SUPPORT is not set
# CONFIG_TRACE is not set
CONFIG_EXT2_FS=y
CONFIG_EXT3_FS=y
CONFIG_EXT4_FS=y
CONFIG_EXT4_FS_SECURITY=y
CONFIG_FUSE_FS=y
CONFIG_MSDOS_FS=y
CONFIG_VFAT_FS=y
CONFIG_TMPFS=y
CONFIG_TMPFS_POSIX_ACL=y
CONFIG_CONFIGFS_FS=y
CONFIG_CRAMFS=y
CONFIG_PSTORE=y
CONFIG_PSTORE_CONSOLE=y
CONFIG_PSTORE_RAM=y
CONFIG_NLS_CODEPAGE_437=y
CONFIG_NLS_ISO8859_1=y
CONFIG_PRINTK_TIME=y
CONFIG_PRINTK_CORE_NUM=y
CONFIG_PRINTK_PROCESS=y
CONFIG_DEBUG_INFO=y
CONFIG_SLUB_DEBUG_ON=y
CONFIG_LOCKUP_DETECTOR=y
CONFIG_BOOTPARAM_SOFTLOCKUP_PANIC=y
CONFIG_PANIC_TIMEOUT=5
CONFIG_SCHEDSTATS=y
CONFIG_TIMER_STATS=y
CONFIG_DEBUG_RT_MUTEXES=y
CONFIG_DEBUG_LOCK_ALLOC=y
CONFIG_DEBUG_ATOMIC_SLEEP=y
CONFIG_DEBUG_LIST=y
CONFIG_ENABLE_DEFAULT_TRACERS=y
CONFIG_ATOMIC64_SELFTEST=y
CONFIG_CRYPTO_AUTHENC=y
CONFIG_CRYPTO_CBC=y
CONFIG_CRYPTO_HMAC=y
CONFIG_CRYPTO_MD5=y
CONFIG_CRYPTO_SHA1=y
CONFIG_CRYPTO_AES=y
CONFIG_CRYPTO_DES=y
CONFIG_CRYPTO_DEFLATE=y
CONFIG_LIBCRC32C=y
CONFIG_CPU_FREQ=y
CONFIG_CPU_FREQ_DEFAULT_GOV_INTERACTIVE=y
CONFIG_CPU_FREQ_GOV_PERFORMANCE=y
CONFIG_CPU_FREQ_GOV_USERSPACE=y
CONFIG_ARM_EXYNOS_MP_CPUFREQ=y
CONFIG_PM_DEVFREQ=y
CONFIG_ARM_EXYNOS_DEVFREQ=y
CONFIG_ECT=y
CONFIG_ECT_DUMP=y
```

## arch/arm64/configs/exynos7870-eng_defconfig
```kconfig
#
# Kernel Performance Events and Counters
#

CONFIG_HW_PERF_EVENTS=y
CONFIG_PERF_EVENTS=y
CONFIG_FTRACE=y
CONFIG_HIGH_RES_TIMERS=y
CONFIG_LOCAL_TIMERS=y
CONFIG_GATOR=m

#
# SAMSUNG EXYNOS SoCs Support
#
CONFIG_EXYNOS_ASV_MARGIN_TEST=y

#
# Kernel hacking
#
CONFIG_SLUB_DEBUG_ON=y
# CONFIG_DEBUG_KMEMLEAK is not set
CONFIG_DEBUG_PREEMPT=y
CONFIG_DEBUG_RT_MUTEXES=y
CONFIG_DEBUG_PI_LIST=y
CONFIG_DEBUG_SPINLOCK=y
CONFIG_DEBUG_MUTEXES=y
CONFIG_DEBUG_LOCK_ALLOC=y
CONFIG_PROVE_LOCKING=y
CONFIG_DEBUG_ATOMIC_SLEEP=y
CONFIG_DEBUG_STACK_USAGE=y
CONFIG_DEBUG_MEMORY_INIT=y
CONFIG_DEBUG_LIST=y
CONFIG_DEBUG_SG=y
CONFIG_SLUB_DEBUG=y

CONFIG_TIMER_STATS=y
CONFIG_SCHEDSTATS=y

#
# RCU Debugging
#
# CONFIG_DEBUG_PAGEALLOC is not set
CONFIG_ATOMIC64_SELFTEST=y

#
# Character devices
#
CONFIG_DEVMEM=y

#
# Support T32 onchip breakpoint
#
CONFIG_SKIP_HW_BREAKPOINT=y

# BAT Automation Test Feature
CONFIG_SEC_BAT_AUT=y

# GPIO DVS
CONFIG_SEC_GPIO_DVS=y
```

## arch/arm64/configs/tima_defconfig
```kconfig
CONFIG_TIMA=y
CONFIG_TIMA_LKMAUTH=y
CONFIG_TIMA_RKP=y
CONFIG_TIMA_LOG=y
CONFIG_KNOX_KAP=y
CONFIG_TZ_ICCC=y
```

## drivers/soc/samsung/Kconfig
```kconfig
#
# EXYNOS Soc drivers
#
menuconfig SOC_SAMSUNG
	bool "SAMSUNG SOC drivers support"

if SOC_SAMSUNG
config EXYNOS_CHIPID
	bool "Exynos Chip ID Driver Support"
	depends on ARCH_EXYNOS
	select SOC_BUS
config EXYNOS_REBOOT
	bool "Exynos Chip Reboot Driver Support"
	depends on ARCH_EXYNOS

config SAMSUNG_DMADEV
	bool
	select ARM_AMBA
	select DMADEVICES
	select PL330_DMA if (ARCH_EXYNOS7 || ARCH_EXYNOS8)
	help
	  Use DMA device engine for PL330 DMAC.

config SAMSUNG_CORE_TEST
	bool "Show system-control registers"
	depends on ARCH_EXYNOS
	help
	  Show system-control registers.

config ECT
	bool "Enable Exynos Characteristic Table File"
	default n
	depends on ARCH_EXYNOS

config ECT_DUMP
	bool "Enable Exynos Characteristic Table File Dump sysfs"
	default n
	depends on ECT

config EXYNOS_CONTENT_PATH_PROTECTION
	bool "Exynos Content Path Protection"
	default y
	help
	  Enable content path protection of EXYNOS.

config EXYNOS_HOTPLUG_GOVERNOR
	bool "Enable Exynos dynamic hotplug governor"

config EXYNOS_MCINFO
	bool "Exynos memory controller information"
	default n

config MCINFO_SYSFS
	bool "Exynos memory controller information sysfs"
	depends on EXYNOS_MCINFO
	default	y if SYSFS

endif #SOC_SAMSUNG
```

## drivers/staging/samsung/Kconfig
```kconfig
# drivers/staging/samsung/Kconfig
#
# Copyright (c) 2010-2011 Samsung Electronics Co., Ltd.
#		http://www.samsung.com/
#
# Licensed under GPLv2

comment "Samsung TN Features"
menuconfig SEC_EXT
	bool "Samsung TN extension features"
	default y

config SEC_SYSFS
	bool "Create a sysfs node for SEC_CLASS"
	depends on SEC_EXT
	default y

config SEC_REBOOT
	bool "Enable TN reboot features"
	depends on SEC_EXT
	default y

menuconfig SEC_DEBUG
	bool "Enable TN debugging features"
	depends on EXYNOS_SNAPSHOT && SEC_REBOOT
	default y

config SEC_DEBUG_LAST_KMSG
	bool "Write last_kmsg at /proc/last_kmsg"
	depends on SEC_DEBUG
	default y

config SEC_DEBUG_USER_RESET
	bool "USER RESET debug feature"
	depends on SEC_DEBUG
	default n
	help
	  This option enables debugging log for User Reset.
	  This option provides reset history log in user version.
	  This option enable proc/reset_reason support

config SEC_DEBUG_MDM_SEPERATE_CRASH
	bool "Enable modem crash with seperated command"
	depends on SEC_DEBUG
	default n
	help
	  This option enables modem crash other debug level.

config SEC_DEBUG_FILE_LEAK
	bool "Panic when file leak detected"
	depends on SEC_DEBUG
	default n

comment "Samsung TN BSP Options"
config SEC_BOOTSTAT
	bool "Samsung TN BSP Feature"
	depends on SEC_EXT
	default y

config SEC_INITCALL_DEBUG
	bool "Enable Samsung initcall debug support"
	depends on SEC_EXT
	default y

config SEC_MISC
	bool "Samsung TN Misc Feature"
	depends on SEC_EXT
	default n
	help
	  Samsung TN Misc extension Feature.

config ARGOS
	bool "Throughput monitoring Feature"
	default n
	help
	  Check throughput and set appropriate system parameters(CPU freq, affinity, etc)

config SEC_SLOW_MODE
	bool "check whether slow cpu load is full"
	depends on SCHED_HMP && CPU_FREQ
	default n
	help
	  fast cpu can help slow cpu when only slow cpu load is busy

comment "Samsung TN Logging Options"
config SEC_AVC_LOG
	default n
	bool "Enable avc audit log support" if EMBEDDED
	depends on SEC_EXT
	help
	  This option enables additional log buffer for audit log.

config SEC_DEBUG_TSP_LOG
	default n
	bool "Enable tsp log support" if EMBEDDED
	depends on SEC_EXT
	help
	  This option enables additional log buffer for tsp log.

comment "Samsung TN Power Management Options"
menuconfig SEC_PM
	bool "Samsung TN Power Management"
	default y
	help
	  Samsung TN Power Management.

config SEC_PM_DEBUG
	bool "Enable Samsung TN Power management debug support"
	default y
	depends on SEC_PM
	help
	  Enable Samsung TN Power management debug support.

comment "PARAM Feature"
config SEC_PARAM
	bool "Samsung TN Param Feature"
	default n
	depends on SEC_DEBUG
	help
	  Samsung TN Param Feature.
```

## drivers/video/fbdev/exynos/decon_7870/panels/Kconfig
```kconfig
config EXYNOS_DECON_LCD
	depends on EXYNOS_DECON_7870
	bool "Select LCD panel driver"

config EXYNOS_DECON_LCD_SYSFS
	depends on EXYNOS_DECON_LCD
	tristate "Support LCD SYSFS"
	default y

config PANEL_AID_DIMMING
	depends on EXYNOS_DECON_LCD
	tristate "Support AID Dimming"
	default n

config EXYNOS_DECON_MDNIE_LITE
	depends on EXYNOS_DECON_LCD
	tristate "Support MDNIE LITE"
	default n

config PANEL_EA8064G_DYNAMIC
	depends on EXYNOS_DECON_LCD && EXYNOS_MIPI_DSI
	tristate "EA8064G Amoled FHD driver(1080 x 1920)"

config PANEL_S6E3FA3_J7XE
	depends on EXYNOS_DECON_LCD && EXYNOS_MIPI_DSI
	tristate "S6E3FA3 J7XE LCD driver"

config PANEL_S6E3FA3_A7MAX
	depends on EXYNOS_DECON_LCD && EXYNOS_MIPI_DSI
	tristate "S6E3FA3 A7MAX LCD driver"

config PANEL_EA8061S_J7XE
	depends on EXYNOS_DECON_LCD && EXYNOS_MIPI_DSI
	tristate "EA8061S Amoled driver"

config PANEL_LTL101AL06
	depends on EXYNOS_DECON_LCD && EXYNOS_MIPI_DSI
	tristate "LTL101AL06 TFT HD driver(1280 x 800)"

config PANEL_S6D7AA0
	depends on EXYNOS_DECON_LCD && EXYNOS_MIPI_DSI
	tristate "S6D7AA0 TFT HD driver(800 x 1280)"

config PANEL_HX8279D
	depends on EXYNOS_DECON_LCD && EXYNOS_MIPI_DSI
	tristate "HX8279D TFT WUXGA driver(1200 x 1920)"

config EXYNOS_LCD_PWM_BACKLIGHT
	depends on EXYNOS_DECON_LCD && EXYNOS_MIPI_DSI
	tristate "EXYNOS_LCD_PWM_BACKLIGHT"
```
